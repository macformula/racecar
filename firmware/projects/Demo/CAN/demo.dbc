VERSION ""

BS_:

BU_: SEND RECV

BO_ 940 ButtonStatus: 1 SEND
    SG_ State : 0|1@1+ (1,0) [0|1] "bool" RECV
