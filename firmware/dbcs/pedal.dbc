VERSION ""

BS_:

BU_: FRONTCONTROLLER

BO_ 2364540158 APPS: 8 FRONTCONTROLLER
	SG_ APPS1 : 0|16@1+ (1,0) [0|100] "percent" Vector__XXX
	SG_ APPS2 : 16|16@1+ (1,0) [0|100] "percent" Vector__XXX

CM_ SG_ 2364540158 APPS1 "Accel Pedal 1";
CM_ SG_ 2364540158 APPS2 "Accel Pedal 2";
