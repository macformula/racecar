VERSION ""

NS_ :

BS_:

BU_: Dash FC
VAL_TABLE_ status_enum 7 "motor_run_error" 6 "hv_run_error" 5 "driver_interface_error" 4 "motor_startup_error" 3 "hv_startup_error" 2 "running" 1 "starting_up" 0 "init" ;

BO_ 255 Gov_e_diagSts: 1 FC
 SG_ control_status : 7|8@0+ (1,0) [0|255] ""  Dash

BA_DEF_  "BusType" STRING ;
BA_DEF_DEF_  "BusType" "CAN";
VAL_ 255 control_status 7 "motor_run_error" 6 "hv_run_error" 5 "driver_interface_error" 4 "motor_startup_error" 3 "hv_startup_error" 2 "running" 1 "starting_up" 0 "init" ;
